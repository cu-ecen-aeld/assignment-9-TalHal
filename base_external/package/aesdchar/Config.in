## base_external/package/aesdchar/Config.in
```kconfig
config BR2_PACKAGE_AESDCHAR
	bool "aesdchar"
	help
	  Includes the aesdchar kernel module in the kernel image.
	  Used to understand buildroot external trees and package builds.
```
